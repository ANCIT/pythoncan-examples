/*@!Encoding:1252*/
includes
{
  
}
variables 
{
  message 0x09 m1;
  message 0x08 m2;
  message 0x07 m3;
  msTimer ms1;
}
on key 'a'
{
  m1.dlc= 4;
  m1.byte(0)=0x18;
  m1.byte(1)=0;
  m1.byte(2)=0;
  m1.byte(3)=0;
  output(m1);
}
on key 'b'
{
  m1.dlc= 4;
  m1.byte(0)=0x35;
  m1.byte(1)=0;
  m1.byte(2)=0;
  m1.byte(3)=0;
  output(m1);
}
  on message 0x09
  {
    if(m1.byte(0)==0x18)
    {
  m3.dlc=3;
m3.byte(0)=0;
  output(m3);
}
    else if(m1.byte(0)==0x35)
    {
  m3.dlc=3;
m3.byte(0)=1;
  output(m3);
}
  }
  on start
{
setTimer(ms1,100); // initialize timer to 100 msec
} 
  on timer ms1
  {
  setTimer(ms1,100);
  m2.dlc=4;
  m2.byte(0)=70;
  m2.byte(1)=0;
  m2.byte(2)=0;
  m2.byte(3)=0;
  output(m2);
}
 
    