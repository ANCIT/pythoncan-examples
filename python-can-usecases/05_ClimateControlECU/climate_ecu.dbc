VERSION ""

NS_ :

BS_:

BU_:

BO_ 7 climate_control_signal: 8 Vector__XXX
 SG_ ac_status : 0|1@1+ (1,0) [0|0] "" Vector__XXX

BO_ 9 climate_simulation_data: 8 Vector__XXX
 SG_ indoor_temp : 8|11@1- (1,0) [0|0] "" Vector__XXX

BO_ 8 vehicle_simulation_data: 8 Vector__XXX
 SG_ engine_speed : 26|14@1- (1,0) [-8192|8191] "" Vector__XXX
 SG_ vehicle_speed : 8|16@1- (1,0) [0|0] "" Vector__XXX
